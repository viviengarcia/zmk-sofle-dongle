/ {

    behaviors {

        sltht: smart_layer_tap_high_thumbs {
            compatible = "zmk,behavior-hold-tap";
            #binding-cells = <2>;
            flavor = "tap-preferred";
            tapping-term-ms = <300>;
            bindings = <&sl>, <&kp>;
            display-name = "Smart Layer-Tap High Thumbs";
        };

    };
};
